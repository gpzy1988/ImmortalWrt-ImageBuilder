## mediatek-filogic/cudy_tr3000-512mb-v1-kernel.bin.its
```
/dts-v1/;

/ {
	description = "ARM64 OpenWrt FIT (Flattened Image Tree)";
	#address-cells = <1>;

	images {
		kernel-1 {
			description = "ARM64 OpenWrt Linux-6.18.41";
			data = /incbin/("/home/guo/immortalwrt/build_dir/target-aarch64_cortex-a53_musl/linux-mediatek_filogic/cudy_tr3000-512mb-v1-kernel.bin");
			type = "kernel";
			arch = "arm64";
			os = "linux";
			compression = "lzma";
			load = <0x48000000>;
			entry = <0x48000000>;
			hash-1 {
				algo = "crc32";
			};
			hash-2 {
				algo = "sha1";
			};
		};


		fdt-1 {
			description = "ARM64 OpenWrt cudy_tr3000-512mb-v1 device tree blob";
			
			data = /incbin/("/home/guo/immortalwrt/build_dir/target-aarch64_cortex-a53_musl/linux-mediatek_filogic/image-mt7981b-cudy-tr3000-512mb-v1.dtb");
			type = "flat_dt";
			
			arch = "arm64";
			compression = "none";
			hash-1 {
				algo = "crc32";
			};
			hash-2 {
				algo = "sha1";
			};
		};



	};

	configurations {
		default = "config-1";
		config-1 {
			description = "OpenWrt cudy_tr3000-512mb-v1";
			kernel = "kernel-1";
			fdt = "fdt-1";
			
			
			
		};
		
	};
};
```
